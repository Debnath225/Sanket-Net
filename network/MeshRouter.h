#ifndef SANKATNET_MESH_ROUTER_H
#define SANKATNET_MESH_ROUTER_H

#include <Arduino.h>
#include <string.h>

#include "../config/NodeConfig.h"
#include "Packet.h"
#include "PacketCodec.h"
#include "LoRaDriver.h"


namespace SankatNet {


class MeshRouter {

public:

    // ========================================================
    // ROUTE INFORMATION
    // ========================================================

    struct RouteEntry {

        uint16_t destination;

        uint16_t nextHop;

        uint8_t hopCount;

        int16_t rssi;

        int8_t snr;

        uint32_t lastSeen;

        bool valid;
    };


    // ========================================================
    // INITIALIZATION
    // ========================================================

    bool begin(
        LoRaDriver* radio
    )
    {
        lora = radio;

        clearRoutes();

        clearDuplicateCache();

        initialized =
            (lora != nullptr);

        return initialized;
    }


    // ========================================================
    // PROCESS RECEIVED PACKET
    // ========================================================

    bool processReceived(
        const uint8_t* rawPacket,
        size_t packetLength,
        PacketContainer& packet,
        bool& shouldForward
    )
    {
        shouldForward = false;


        if (
            !initialized ||
            rawPacket == nullptr
        ) {
            return false;
        }


        // ----------------------------------------------------
        // Decode packet
        // ----------------------------------------------------

        if (
            !decodePacket(
                rawPacket,
                packetLength,
                packet
            )
        ) {
            return false;
        }


        // ----------------------------------------------------
        // Ignore packets generated by this node
        // ----------------------------------------------------

        if (
            packet.header.sourceNode ==
            NODE_ID
        ) {
            return false;
        }


        // ----------------------------------------------------
        // Update neighbor information
        // ----------------------------------------------------

        updateNeighborRoute(
            packet.header.sourceNode,
            packet.header.hopCount,
            lora->getRSSI(),
            lora->getSNR()
        );


        // ----------------------------------------------------
        // Check duplicate packet
        // ----------------------------------------------------

        if (
            isDuplicate(
                packet.header.sourceNode,
                packet.header.sequence
            )
        ) {
            return false;
        }


        rememberPacket(
            packet.header.sourceNode,
            packet.header.sequence
        );


        // ----------------------------------------------------
        // Packet for this node?
        // ----------------------------------------------------

        if (
            isForThisNode(
                packet.header.destinationNode
            )
        ) {

            shouldForward = false;

            return true;
        }


        // ----------------------------------------------------
        // Packet not for this node
        // ----------------------------------------------------

        if (
            packet.header.ttl <= 1
        ) {
            return true;
        }


        // ----------------------------------------------------
        // Routing enabled?
        // ----------------------------------------------------

        if (
            !MeshConfig::ROUTING_ENABLED
        ) {
            return true;
        }


        // ----------------------------------------------------
        // Prepare forwarding
        // ----------------------------------------------------

        packet.header.ttl--;

        packet.header.hopCount++;


        shouldForward = true;

        return true;
    }

    bool route(
        PacketContainer& packet,
        bool& shouldForward
    )
    {
        shouldForward = false;

        if (!initialized || packet.header.sourceNode == NODE_ID) {
            return false;
        }

        updateNeighborRoute(
            packet.header.sourceNode,
            packet.header.hopCount,
            lora->getRSSI(),
            lora->getSNR()
        );

        if (isForThisNode(packet.header.destinationNode)) {
            return true;
        }

        if (!MeshConfig::ROUTING_ENABLED || packet.header.ttl <= 1) {
            return false;
        }

        packet.header.ttl--;
        packet.header.hopCount++;
        shouldForward = true;
        forwardedPackets++;
        return true;
    }


    // ========================================================
    // FORWARD PACKET
    // ========================================================

    bool forward(
        PacketContainer& packet
    )
    {
        if (
            !initialized
        ) {
            return false;
        }


        if (
            packet.header.ttl == 0
        ) {
            return false;
        }


        if (
            packet.header.hopCount >
            MeshConfig::MAX_FORWARD_HOPS
        ) {
            return false;
        }


        uint8_t encoded[
            MAX_LORA_PACKET_SIZE
        ];


        size_t encodedLength = 0;


        if (
            !PacketCodec::encode(
                packet,
                encoded,
                sizeof(encoded),
                encodedLength
            )
        ) {
            return false;
        }


        return lora->transmit(
            encoded,
            encodedLength
        );
    }


    // ========================================================
    // ROUTE LOOKUP
    // ========================================================

    bool findRoute(
        uint16_t destination,
        RouteEntry& result
    ) const
    {
        for (
            uint8_t i = 0;
            i < MAX_ROUTES;
            i++
        ) {

            if (
                routes[i].valid &&
                routes[i].destination ==
                    destination
            ) {

                result =
                    routes[i];

                return true;
            }
        }


        return false;
    }


    // ========================================================
    // GET NEXT HOP
    // ========================================================

    uint16_t getNextHop(
        uint16_t destination
    ) const
    {
        RouteEntry route;

        if (
            findRoute(
                destination,
                route
            )
        ) {

            return route.nextHop;
        }


        /*
         * Gateway is the default destination.
         *
         * If no specific route is known, broadcasting is
         * used so neighboring nodes can continue discovery.
         */

        if (
            destination ==
            GATEWAY_ID
        ) {

            return BROADCAST_ID;
        }


        return BROADCAST_ID;
    }


    // ========================================================
    // UPDATE ROUTE
    // ========================================================

    void updateRoute(
        uint16_t destination,
        uint16_t nextHop,
        uint8_t hopCount,
        int16_t rssi,
        int8_t snr
    )
    {
        int index =
            findRouteIndex(
                destination
            );


        if (
            index < 0
        ) {

            index =
                findFreeRouteIndex();
        }


        if (
            index < 0
        ) {

            /*
             * Replace the oldest route.
             */

            index =
                findOldestRouteIndex();
        }


        if (
            index < 0
        ) {
            return;
        }


        routes[index].destination =
            destination;

        routes[index].nextHop =
            nextHop;

        routes[index].hopCount =
            hopCount;

        routes[index].rssi =
            rssi;

        routes[index].snr =
            snr;

        routes[index].lastSeen =
            millis();

        routes[index].valid =
            true;
    }


    // ========================================================
    // NEIGHBOR ROUTE
    // ========================================================

    void updateNeighborRoute(
        uint16_t neighbor,
        uint8_t hopCount,
        int16_t rssi,
        float snr
    )
    {
        int8_t snrRounded;

        if (
            snr > 127.0f
        ) {
            snrRounded = 127;
        }

        else if (
            snr < -128.0f
        ) {
            snrRounded = -128;
        }

        else {
            snrRounded =
                static_cast<int8_t>(
                    snr
                );
        }


        /*
         * The neighbor itself is one hop away.
         */

        updateRoute(
            neighbor,
            neighbor,
            1,
            rssi,
            snrRounded
        );


        /*
         * If the neighbor advertises a route farther
         * into the network, the received hop information
         * can be used by future route advertisements.
         */
        (void)hopCount;
    }


    // ========================================================
    // ROUTE MAINTENANCE
    // ========================================================

    void expireRoutes(
        uint32_t maxAgeMs
    )
    {
        uint32_t now =
            millis();


        for (
            uint8_t i = 0;
            i < MAX_ROUTES;
            i++
        ) {

            if (
                !routes[i].valid
            ) {
                continue;
            }


            if (
                now -
                routes[i].lastSeen >
                maxAgeMs
            ) {

                routes[i].valid =
                    false;
            }
        }
    }


    // ========================================================
    // DUPLICATE DETECTION
    // ========================================================

    bool isDuplicate(
        uint16_t source,
        uint32_t sequence
    ) const
    {
        for (
            uint8_t i = 0;
            i < MeshConfig::DUPLICATE_CACHE_SIZE;
            i++
        ) {

            if (
                duplicateCache[i].valid &&
                duplicateCache[i].source ==
                    source &&
                duplicateCache[i].sequence ==
                    sequence
            ) {

                return true;
            }
        }


        return false;
    }


    // ========================================================
    // REMEMBER PACKET
    // ========================================================

    void rememberPacket(
        uint16_t source,
        uint32_t sequence
    )
    {
        duplicateCache[
            duplicateCacheIndex
        ].source =
            source;


        duplicateCache[
            duplicateCacheIndex
        ].sequence =
            sequence;


        duplicateCache[
            duplicateCacheIndex
        ].valid =
            true;


        duplicateCacheIndex++;


        if (
            duplicateCacheIndex >=
            MeshConfig::DUPLICATE_CACHE_SIZE
        ) {

            duplicateCacheIndex = 0;
        }
    }


    // ========================================================
    // CREATE HEADER
    // ========================================================

    void initializeHeader(
        PacketHeader& header,
        PacketType type,
        uint16_t destination,
        uint32_t sequence
    )
    {
        memset(
            &header,
            0,
            sizeof(PacketHeader)
        );


        header.magic =
            PACKET_MAGIC;

        header.version =
            PACKET_VERSION;

        header.packetType =
            static_cast<uint8_t>(
                type
            );

        header.flags =
            FLAG_NONE;

        header.sourceNode =
            NODE_ID;

        header.destinationNode =
            destination;

        header.sequence =
            sequence;

        header.ttl =
            MeshConfig::DEFAULT_TTL;

        header.hopCount =
            0;

        header.timestamp =
            millis();
    }


    // ========================================================
    // STATISTICS
    // ========================================================

    uint32_t getForwardedPackets() const
    {
        return forwardedPackets;
    }


    uint32_t getDroppedPackets() const
    {
        return droppedPackets;
    }


    uint8_t getRouteCount() const
    {
        uint8_t count = 0;


        for (
            uint8_t i = 0;
            i < MAX_ROUTES;
            i++
        ) {

            if (
                routes[i].valid
            ) {
                count++;
            }
        }


        return count;
    }


private:

    bool isForThisNode(
        uint16_t destination
    ) const
    {
        return destination == NODE_ID ||
               destination == BROADCAST_ID ||
               (destination == GATEWAY_ID &&
                NODE_ID == GATEWAY_ID);
    }

    // ========================================================
    // LIMITS
    // ========================================================

    static constexpr uint8_t MAX_ROUTES =
        16;


    // ========================================================
    // ROUTES
    // ========================================================

    RouteEntry routes[
        MAX_ROUTES
    ] = {};


    // ========================================================
    // DUPLICATE CACHE
    // ========================================================

    struct DuplicateEntry {

        uint16_t source;

        uint32_t sequence;

        bool valid;
    };


    DuplicateEntry duplicateCache[
        MeshConfig::DUPLICATE_CACHE_SIZE
    ] = {};


    uint8_t duplicateCacheIndex = 0;


    // ========================================================
    // RADIO
    // ========================================================

    LoRaDriver* lora = nullptr;


    bool initialized = false;


    // ========================================================
    // STATISTICS
    // ========================================================

    uint32_t forwardedPackets = 0;

    uint32_t droppedPackets = 0;


    // ========================================================
    // ROUTE SEARCH
    // ========================================================

    int findRouteIndex(
        uint16_t destination
    ) const
    {
        for (
            uint8_t i = 0;
            i < MAX_ROUTES;
            i++
        ) {

            if (
                routes[i].valid &&
                routes[i].destination ==
                    destination
            ) {

                return i;
            }
        }


        return -1;
    }


    int findFreeRouteIndex() const
    {
        for (
            uint8_t i = 0;
            i < MAX_ROUTES;
            i++
        ) {

            if (
                !routes[i].valid
            ) {

                return i;
            }
        }


        return -1;
    }


    int findOldestRouteIndex() const
    {
        int oldestIndex = -1;

        uint32_t oldestTime =
            UINT32_MAX;


        for (
            uint8_t i = 0;
            i < MAX_ROUTES;
            i++
        ) {

            if (
                routes[i].valid &&
                routes[i].lastSeen <
                    oldestTime
            ) {

                oldestTime =
                    routes[i].lastSeen;

                oldestIndex =
                    i;
            }
        }


        return oldestIndex;
    }


    // ========================================================
    // CLEAR ROUTES
    // ========================================================

    void clearRoutes()
    {
        for (
            uint8_t i = 0;
            i < MAX_ROUTES;
            i++
        ) {

            routes[i].valid =
                false;
        }
    }


    // ========================================================
    // CLEAR DUPLICATE CACHE
    // ========================================================

    void clearDuplicateCache()
    {
        for (
            uint8_t i = 0;
            i < MeshConfig::DUPLICATE_CACHE_SIZE;
            i++
        ) {

            duplicateCache[i].valid =
                false;
        }


        duplicateCacheIndex = 0;
    }


    // ========================================================
    // PACKET ENCODING
    // ========================================================

    bool encodePacket(
        const PacketContainer& packet,
        uint8_t* buffer,
        size_t bufferSize,
        size_t& length
    )
    {
        return PacketCodec::encode(packet, buffer, bufferSize, length);
    }


    // ========================================================
    // PACKET DECODING
    // ========================================================

    bool decodePacket(
        const uint8_t* buffer,
        size_t length,
        PacketContainer& packet
    )
    {
        return PacketCodec::decode(buffer, length, packet);
    }


    bool PacketCodecHeaderValid(
        const PacketHeader& header
    ) const
    {
        if (
            header.magic !=
            PACKET_MAGIC
        ) {
            return false;
        }


        if (
            header.version !=
            PACKET_VERSION
        ) {
            return false;
        }


        if (
            !isValidPacketType(
                header.packetType
            )
        ) {
            return false;
        }


        if (
            header.ttl == 0
        ) {
            return false;
        }


        if (
            header.hopCount >
            MeshConfig::MAX_FORWARD_HOPS
        ) {
            return false;
        }


        return true;
    }
};


} // namespace SankatNet


#endif